## arch/riscv/Kconfig
```kconfig
menu "Riscv architecture"
	depends on RISCV

config SYS_ARCH
	default "riscv"

choice
	prompt "Target select"
	optional

config TARGET_RISCV_GENERIC
	bool "Support riscv-generic"

endchoice

source "board/riscv/riscv-generic/Kconfig"

endmenu
```

## board/LowRISC/ariane/Kconfig
```kconfig
if TARGET_LOWRISC_ARIANE

config SYS_CPU
	default "ariane"

config SYS_BOARD
	default "ariane"

config SYS_VENDOR
	default "LowRISC"

config SYS_SOC
	default "lowrisc"

config SYS_CONFIG_NAME
	default "lowrisc-ariane"

config ENV_SIZE
	default 0x2000 if ENV_IS_IN_SPI_FLASH

config ENV_OFFSET
	default 0x140000 if ENV_IS_IN_SPI_FLASH

config UART_SBI
        default y
        
endif
```
